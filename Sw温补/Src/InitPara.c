#define INIT_EXT
#include"Include.h"

const uint8 code InitPara0[]@0x800=
{
    0x11,0x11,0x11,0x11,0x11,0x11,  //通讯地址
    0x01,0x00,0x00,0x00,0x00,0x00,  //表号

    0x00,0x00,0x00,0x00,0x00,0x00,0x00,0x00,
    0x00,0x00,0x00,0x00,0x00,0x00,0x00,0x00,
    0x00,0x00,0x00,0x00,0x00,0x00,0x00,0x00,
    0x00,0x00,0x00,0x00,0x00,0x00,0x00,0x00,    //资产管理编码

    0,0,'V','0','2','2',    //额定电压
    0,0,0,0,'A','5',        //额定电流
    0,0,0,'A','0','6',      //最大电流
};

const uint8 code InitPara1[]@0x83E=
{
    0x00,'0','.','2',               //有功准确度等级
    0x00,0x00,0x00,0x00,0x00,       //电表位置信息
    0x00,0x00,0x00,0x00,0x00,0x00,           

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    0xf0,0x00,                      //编程有效时间(自扩)
};

const uint8 code InitPara2[]@0x87C=
{
    0x80,0x00,  //校表脉冲宽度
    0x00,0x00,  //电表运行状态字1
    0x00,0x00,  //电表运行状态字2
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    0x00,0x00,0x00,0x00,0x00,0x00,0x00,0x00,    //厂家编号
};

const uint8 code InitPara3[]@0x8BA=
{
    0x00,0x00,0x00,     //第一级密码
    0x00,0x00,0x00,     //第二级密码
    0x56,0x34,0x12,     //第三级密码
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    0x00,                   //电表运行特征字（不启用后续标志）  
};

const uint8 code InitPara4[]@0x8F8=
{
    0x00,                   //RTC温度常温偏移
    0x00,0x00,0x00,0x00,    //RTC晶体常温偏移
    0x18,                   //RTC顶点温度
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    0x68,0xBA,0x05,0x00,    //RTC的B值
    //CRC
};

const uint8 code InitPara5[sizeof(S_JBPM)-2]@0x912=
{
    0xB0,0x04,     //表常数
    0xf0,0x55,     //标称电压
    0x88,0x13,     //标称电流
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    0x03,               //通道增益
    //CRC
};


const uint8 code InitPara6[]@0x94F=
{
    0x00,0x00,0x18,0x23,0x05,0x12,0x03,//当前时钟备份(自扩)
    //当前有功备份的CRC校验(自扩)
//reserved
//自动校表比对参数


};


const uint8 code InitPara7[]@0x956=
{
    0x02,                       //年时区数
    0x02,                       //日时段表数
    0x08,                       //日时段（每组合总电量日切换）
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    0x00,0x00,0x00,0x00,        //密钥状态字
//    0x00,0xfb,0x7e,0xff,0xff,0xff,   //主动上报模式字
    0x30,0x00,          //过流下限 BCD
    0x3C,               //过流延时时间 HEX
    0xA0,0x05,//预跳闸（超拉闸）控制电流门限保护延时时间
    0x1e,     //红外认证时效
};

const uint8 code InitPara8[]@0x994=
{
    0x00,0x04,0x00,0x00,0x00,0x00,0x02,0x00,   //主动上报模式字
    0x1e,                 //主动上报状态字自动复位延时时间
    0x0f,                 //负荷记录模式字   
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    0x00,                 //负荷记录起始标志（年）
};

const uint8 code InitPara9[]@0x9AB=
{
    0x01,0x01,0x01,
    0x02,0x01,0x06,
    0x02,0x01,0x06,
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    0x02,0x01,0x06,  //第一套时区表
};

const uint8 code InitPara10[]@0x9D5=
{
    0x01,0x00,0x00,
    0x02,0x00,0x03,
    0x03,0x00,0x06,
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    0x04,0x00,0x21,
    //第1套第1日时段表
};
const uint8 code InitPara18[]@0x9FF=
{
    0x01,0x01,0x01,
    0x02,0x01,0x06,
    0x02,0x01,0x06,
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    0x02,0x01,0x06,  
    //第二套时区表
};

const uint8 code InitPara19[]@0xA29=
{
    0x01,0x00,0x00,
    0x02,0x00,0x03,
    0x03,0x00,0x06,
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    0x04,0x00,0x21, 
    //第二套第1日时段表
};

const uint8 code InitPara27[]@0xA53=
{

    0x00,0x00,0x00,0x00,0x00,
    0x00,0x00,0x00,0x00,0x00,
    0x00,0x00,0x00,0x00,0x00,
    0x00,0x00,0x00,0x00,0x00,
    0x00,0x00,0x00,0x00,0x00,
    0x00,0x00,0x00,0x00,0x00,
    0x00,0x00,    //厂家软件版本号
};

const uint8 code InitPara28[]@0xA73=
{
    0x00,0x00,0x00,0x00,0x00,
    0x00,0x00,0x00,0x00,0x00,
    0x00,0x00,0x00,0x00,0x00,
    0x00,0x00,0x00,0x00,0x00,
    0x00,0x00,0x00,0x00,0x00,
    0x00,0x00,0x00,0x00,0x00,
    0x00,0x00,    //厂家硬件版本号

};

const uint8 code InitPara29[]@0xA93=
{
    0x00,0x00,0x00,0x00,0x00,       //按显1  当前总电量
    0x00,0x01,0x00,0x00,0x00,       //按显2  当前尖电量
    0x00,0x02,0x00,0x00,0x00,       //按显3  当前峰电量
    0x00,0x03,0x00,0x00,0x00,       //按显4  当前平电量
    0x00,0x04,0x00,0x00,0x00,       //按显5  当前谷电量
    //下面是预留
    0x01,0x01,0x00,0x04,0x00,       //循显6 日期
    0x02,0x01,0x00,0x04,0x00,       //循显7 时间
    0x00,0x00,0x00,0x00,0x00,       //循显8
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    0x00,0x00,0x00,0x00,0x00,       //循显20
};

const uint8 code InitPara37[]@0xAF7=
{
    0x00,0x00,0x00,0x00,0x00,       //按显1  当前总电量
    0x00,0x01,0x00,0x00,0x00,       //按显2  当前尖电量
    0x00,0x02,0x00,0x00,0x00,       //按显3  当前峰电量
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    0x02,0x01,0x00,0x04,0x00,       //按显14 时间

    //下面是预留
    0x02,0x00,0x00,0x00,0x00,       //按显15 上2月组合总电量
    0x02,0x01,0x00,0x00,0x00,       //按显16 上2月组合尖电量
    0x02,0x02,0x00,0x00,0x00,       //按显17 上2月组合峰电量
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    0x00,0x00,0x00,0x00,0x00,       //按显41

};

//下面是为了对齐16保留部分
__root const uint8 code InitPara38[]@0xC00=
{   //BGP Wkup LCD1 LCD2 Bat(3600)
    0x02,0x00,0x01,0x03,0x10,0x0e, 
};

//RTC温度曲线K系数
__root const uint8 code InitParaRTC[]@0xD00=
{
    0xE5,0x03,	//0.997 
    0xE8,0x03,	//1.000 
    0xEC,0x03,	//1.004 
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    0xF7,0x03,	//1.015 
};

typedef struct 
{
    const uint8 code* E2ParaTabAdrr;   //E2参数表格地址
    uint16 E2Adrr;          //E2地址
    uint8  uclen;           //数据长度
}GS_E2PARA;

const  GS_E2PARA code PageCRCAddr[]=
{
    {InitPara0,     EEP_COMADD,     sizeof(InitPara0),  },
    {InitPara1,     EEP_YGACCURACY, sizeof(InitPara1),  },
    {InitPara2,     EEP_JBMCKD,     sizeof(InitPara2),  },
    {InitPara3,     EEP_645PASSWD1, sizeof(InitPara3),  },

//  {InitPara5,     EEP_JBTOTAL,    sizeof(InitPara5),  },
    {InitPara6,     EEP_DATETIME,   sizeof(InitPara6),  },

    {InitPara7,     EEP_SQCNT,      sizeof(InitPara7),  },
    {InitPara8,     EEP_ZDSBMSZ,    sizeof(InitPara8),  },
    
    {InitPara9,     EEP_1SQ,        sizeof(InitPara9),  },
    {InitPara10,    EEP_1RSDS1,     sizeof(InitPara10), },

    {InitPara10,    EEP_1RSDS2,     sizeof(InitPara10), },
    {InitPara10,    EEP_1RSDS3,     sizeof(InitPara10), },
    {InitPara10,    EEP_1RSDS4,     sizeof(InitPara10), },
    {InitPara10,    EEP_1RSDS5,     sizeof(InitPara10), },
    {InitPara10,    EEP_1RSDS6,     sizeof(InitPara10), },
    {InitPara10,    EEP_1RSDS7,     sizeof(InitPara10), },
    {InitPara10,    EEP_1RSDS8,     sizeof(InitPara10), },

    {InitPara18,    EEP_2SQ,        sizeof(InitPara18), },
    {InitPara19,    EEP_2RSDS1,     sizeof(InitPara19), },

    {InitPara19,    EEP_2RSDS2,     sizeof(InitPara19), },
    {InitPara19,    EEP_2RSDS3,     sizeof(InitPara19), },
    {InitPara19,    EEP_2RSDS4,     sizeof(InitPara19), },
    {InitPara19,    EEP_2RSDS5,     sizeof(InitPara19), },
    {InitPara19,    EEP_2RSDS6,     sizeof(InitPara19), },
    {InitPara19,    EEP_2RSDS7,     sizeof(InitPara19), },
    {InitPara19,    EEP_2RSDS8,     sizeof(InitPara19), },

    {InitPara27,    EEP_CJRJBB,     sizeof(InitPara27), },
    {InitPara28,    EEP_CJYJBB,     sizeof(InitPara28), },
};

/*=========================================================================================\n
* @function_name: InitE2Data
* @function_file: InitPara.c
* @描述: 
* 
* @参数: 
* @返回: 
* @作者:   lwb (2012-05-04)
* @备注: 
*-------------------------------------------------------------------------------------------
* @修改人:  
* @修改内容: 
===========================================================================================*/
void InitE2Data(uint8 uc_RTCSave)
{
    Word16 CRC;
    uint8 i,j;
    uint16 ShowLen;
    uint16 Wrlen;
    Word16 PrTm;

    ClRCRCWord(guc_InitWd);
    Disp_Clr();
    //通讯地址和表号，参数初始化时不更新
    FCpyTMem(XDATA_RAMZONE,PageCRCAddr[0].E2ParaTabAdrr+12,PageCRCAddr[0].uclen-12);          //拷贝Flash数据到RAM中
    SysE2ParaSetManage(PageCRCAddr[0].E2Adrr+12,XDATA_RAMZONE,PageCRCAddr[0].uclen-12);          //写入顶点温度和B值到E2中
    for(i=1;i<sizeof(PageCRCAddr)/sizeof(GS_E2PARA);i++)
    {
        CLRWDT();               //喂狗
        FCpyTMem(XDATA_RAMZONE,PageCRCAddr[i].E2ParaTabAdrr,PageCRCAddr[i].uclen);//拷贝Flash数据到RAM中
        CRC.word=do_CRC(XDATA_RAMZONE,PageCRCAddr[i].uclen);
        XDATA_RAMZONE[PageCRCAddr[i].uclen]=CRC.byte[0];
        XDATA_RAMZONE[PageCRCAddr[i].uclen+1]=CRC.byte[1];   //拷贝CRC到RAM中
        BE_WriteP(PageCRCAddr[i].E2Adrr,XDATA_RAMZONE,PageCRCAddr[i].uclen+2);   //写入到E2中
     }

    //校表参数单独判断,首先判读E2中的CRC是否正确，如果正确，则不需要初始化
    BE_ReadP(EEP_JBTOTAL,XDATA_RAMZONE,sizeof(S_JBPM));
    if(Uint8_To_Uint16(XDATA_RAMZONE+sizeof(S_JBPM)-2)!=do_CRC(XDATA_RAMZONE,sizeof(S_JBPM)-2))
    {

        CLRWDT();               //喂狗
        FCpyTMem(XDATA_RAMZONE,InitPara5,sizeof(S_JBPM)-2);                     //拷贝Flash数据到RAM中
        CRC.word=do_CRC(XDATA_RAMZONE,sizeof(S_JBPM)-2);
        XDATA_RAMZONE[sizeof(S_JBPM)-2]=CRC.byte[0];
        XDATA_RAMZONE[sizeof(S_JBPM)-1]=CRC.byte[1];                            //拷贝CRC到RAM中
        BE_WriteP(EEP_JBTOTAL,XDATA_RAMZONE,sizeof(S_JBPM));                    //写入到E2中
    }

    //写入轮显参数

    ShowLen=sizeof(InitPara29);
    for(i=0;i<((sizeof(InitPara29)-1)/64+1);i++)
    {

        CLRWDT();               //喂狗
        if(ShowLen>=64)
        {
            FCpyTMem(XDATA_RAMZONE,&InitPara29[i*64],64);    //拷贝Flash数据到RAM中
            Wrlen=64;
            ShowLen-=64;
        }else
        {
            FCpyTMem(XDATA_RAMZONE,&InitPara29[i*64],ShowLen);    //拷贝Flash数据到RAM中
            Wrlen=ShowLen;
        }

        BE_WriteP(EEP_LXTABLE+i*64,XDATA_RAMZONE,Wrlen);          //写入E2中
    }

    //写入键显参数
    ShowLen=sizeof(InitPara37); 
    for(i=0;i<((sizeof(InitPara37)-1)/64+1);i++)            
    {
        CLRWDT();                                                   //喂狗
        if(ShowLen>64)
        {
            FCpyTMem(XDATA_RAMZONE,&InitPara37[i*64],64);           //拷贝Flash数据到RAM中
            Wrlen=64;
            ShowLen-=64;
        }else
        {
            FCpyTMem(XDATA_RAMZONE,&InitPara37[i*64],ShowLen);      //拷贝Flash数据到RAM中
            Wrlen=ShowLen;
        }
        BE_WriteP(EEP_JXTABLE+i*64,XDATA_RAMZONE,Wrlen);            //写入E2中
    }

    CLRWDT();                                                       //喂狗
    
    if(uc_RTCSave == 0x55)
    {
        //写入部分RTC参数
        FCpyTMem(XDATA_RAMZONE,InitPara4+5,21);
        SysE2ParaSetManage(EEP_RTCDDTEMP,XDATA_RAMZONE,21);             //写入顶点温度和B值到E2中
        gui_RefreshEvent |= flgEtPara_RtcParaFsToE2;
        uc_RTCSave = 0;
    }

    CLRWDT();                                                       //喂狗
    MemSet(XDATA_RAMZONE,0x00,64);                                  //先清零外部RAM 
    for(i=0;i<4;i++)
    {
        BE_WriteP(EEP_JRS+64*i,XDATA_RAMZONE,64);                   //公共假日前面清零
    }

    SetCRCWord(guc_ClearWd);
    Data_ClearMeter();                                              //电表清零
 
    MemSet(XDATA_RAMZONE,0x00,64);                                              //先清零外部RAM 
    for(j=0;j<gCs_MeterClearAddrTab[0].ucPageCnt;j++)                           //参数初始化的时候清零电表清零记录
    {
        CLRWDT();               //喂狗
        BE_WriteP(gCs_MeterClearAddrTab[0].uiE2Addr+64*j,XDATA_RAMZONE,64);    //电表清零记录
    }
//
    gs_FeeData.uc_FeeRSDN=0x01;
    gs_FeeData.uc_FeeSQN=0x01;
    gs_MeterState.ui_MeterState3.RunCode3Word.RateTable=false;                  //修改电表状态字，使用第一套时段
    gs_MeterState.ui_MeterState3.RunCode3Word.TimeZoneTable=false;              //修改电表状态字，使用第一套时段
    //主动上报状态字清零
    Rpt_Clr(Const_All);
    MemSet(XDATA_RAMZONE, 0x00, RPTDATLEN);
    BE_WriteP(EEP_RPTDATA,  (uint8 *)XDATA_RAMZONE,       RPTDATLEN);  //从E2恢复
    
    guc_FactoryType = FactorMd;
    gui_DyProDmOut=0x2760;      //7天
    BE_WriteP(EEP_PRODUCELEFTTM,(uint8*)&gui_DyProDmOut,0x02);                  //厂内剩余时间
    SysE2ParaSetManage(EEP_PRODUCE,(uint8*)&guc_FactoryType,1);                 //写入厂内状态

    PrTm.byte[0]=InitPara1[60];
    PrTm.byte[1]=InitPara1[61];
    gui_DyPgmOut=PrTm.word;//编程时间
    

    SleepTimeProc();                                            //从RTC读取时钟到RAM中
    gui_RefreshEvent|=(flgEtPara_Config+flgEtPara_Fee+flgEtPara_Show+flgEtPara_LoadCurve+flgEtPara_PowDir);

    if( gs_DispStt.ucMode == Const_DispMode_Full)
    {
      gs_DispStt.ucTmr = 5;    //持续时间5s
    }
}
