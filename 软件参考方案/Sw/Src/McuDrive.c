#include "Include.h"
/*=========================================================================================\n
* @function_name: Init_Port
* @function_file: main.c
* @描述:
*
* @参数:
* @返回:
* @作者:
* @备注:
*-------------------------------------------------------------------------------------------
* @修改人:  Lwb (2011-7-26)
* @修改内容:
===========================================================================================*/
void Init_Port(void)
{
 //LCD 
    P0IE = 0x00;
    P0OE = 0xff;
    P3IE = 0x00;
    P3OE = 0xff;
    P4IE = 0x00;
    P4OE = 0xff;
    P5IE = 0x00;
    P5OE = 0xff;
    P6IE = 0x00;
    P6OE = 0xff;
    P7IE = 0x00;
    P7OE = 0xff;
    P8IE = 0x00;
    P8OE = 0xff;

    //按键输入
    P1IE |=BIT3;
    P1OE |=BIT3;

    P1IE |=BIT4;
    P1OE |=BIT4;
 
    

    //E2
    P11FS=0;
    P12FS=0;
    BE_I2C_SDA_1();
    BE_I2C_CLK_1();

}
/*=========================================================================================\n
* @function_name: IdleIO
* @function_file: McuDrive.c
* @描述: 闲置IO
* 
* @作者: lwb (2014/3/25)
* @备注: 
*-------------------------------------------------------------------------------------------
* @修改人: 
* @修改内容:  
===========================================================================================*/
void IdleIO(void)
{

    Init_Port();

    //UART4
    P21FS=0;
    P22FS=0;
    P2OE|=(BIT1+BIT2);
    P2IE&=~(BIT1+BIT2);

    //UART2
    P24FS=0;                            
    P25FS=0;                         
    P2OE|=(BIT4+BIT5);
    P2IE&=~(BIT4+BIT5);
 
}
/*=========================================================================================\n
* @function_name: Init_Timer0
* @function_file: main.c
* @描述: 初始化定时器0
*
* @参数:
* @返回:
* @作者:
* @备注:
*-------------------------------------------------------------------------------------------
* @修改人:  Lwb (2011-8-8)
* @修改内容:
===========================================================================================*/
void Init_Timer0(void)
{
    CKCON &= ~BIT3;         //1/12clk
    TMOD &=0xf0;
    TMOD |= 0x01;            //定时器为方式2     
    TH0 = 0xFE;             //定时1ms
    TL0 = 0xEF;             //启动第一次进中断的时间设定
    TR0 = 1;                // 开定时器0
    IE|=BIT1;
}
/*=========================================================================================\n
* @function_name: Init_Timer1
* @function_file: main.c
* @描述: 定时器1定时为1ms
*
* @参数:
* @返回:
* @作者:
* @备注:
*-------------------------------------------------------------------------------------------
* @修改人:  Lwb (2011-8-9)
* @修改内容:
===========================================================================================*/
void Init_Timer1(void)
{

}
/*=========================================================================================\n
* @function_name: Init_Timer2
* @function_file: McuDrive.c
* @描述: 定时器2初始化 1ms
*
* @参数:
* @返回:
* @作者:   lwb (2012-03-20)
* @备注:
*-------------------------------------------------------------------------------------------
* @修改人:
* @修改内容:
===========================================================================================*/
void Init_Timer2(void)
{
    CKCON &= ~BIT5;     // 1/12clk
    T2CON &= ~BIT1;     // 做定时器用
    T2CON&=~BIT0;       //重新加载模式    

    TH2=0xF5;
    TL2=0x65;
    RACAP2H=0xF5;
    RACAP2L=0x65;
    
    TR2=1;              //开始计时
    IE |= BIT5;         // TIME2 interrupt

}
/*=========================================================================================\n
* @function_name: RAMInit
* @function_file: McuDriver.c
* @描述: 关闭加密功能
*
* @参数:
* @返回:
* @作者:   lim (2011-12-11)
* @备注:
*-------------------------------------------------------------------------------------------
* @修改人:
* @修改内容:
===========================================================================================*/
void RAMInit(void)
{
    XRAMPWD=0x33;   //解除保护
}
/*=========================================================================================\n
* @function_name: Init_RTC
* @function_file: McuDrive.c
* @描述: 初始化RTC
*
* @参数:
* @返回:
* @作者:   lwb (2012-03-23)
* @备注:
*-------------------------------------------------------------------------------------------
* @修改人:
* @修改内容:
===========================================================================================*/
void Init_RTC(uint8 ucWakeUpTm)
{
    //RTC允许写 
    RTCPEN = 0x96;  //password 1
    RTCPWD = 0xd7;  //password 2
    TSRC=0;         //使用低频作为RTC时钟
    
    INTRTC=ucWakeUpTm;  //1天唤醒
    RTCHCH=0;           //高频补偿为0
    RTCHCL=0;
                        //低频补偿为0
    RTCLCH=0;
    RTCLCL=0;
    
   // RTC禁止写 
    RTCPEN = 0x96;  //
    RTCPWD = 0xd6;
}

/*=========================================================================================\n
* @function_name: CPUInit
* @function_file: Init.c
* @描述: 初始化MCU的LCD ，TIMER0和
*
* @参数:
* @返回:
* @作者:   lim (2011-12-10)
* @备注:
*-------------------------------------------------------------------------------------------
* @修改人:
* @修改内容:
===========================================================================================*/
void CPUInit(void)
{
    CLRWDT();               //喂狗
    RAMInit();              //解除RAM保护
    Init_Port();            //初始化IO
    InitLCD();              //LCD初始化
    Init_Uart4(0,0);        //初始化485
    Init_Uart2(0,0);        //初始化红外
    ComBom_InitAll();       //初始化所有串口
    Init_Timer0();          //初始化定时器1
    Init_Timer2();          //初始化定时器2
    KeyInit();              //初始化按键
    Init_RTC(RTC_DAY);      //初始化RTC
}

/* bit of CrtlCLK */
#define     MCUCLKSEL0  BIT0
#define     MCUCLKSEL1  BIT1
#define     ADCLKSEL0   BIT2
#define     ADCLKSEL1   BIT3
#define     PLLSEL      BIT4
#define     BGPPDN      BIT5
#define     PLLPDN      BIT6
#define     BGPPDNB     BIT7

//=======================================================
//函数名：Set_PLL
//函数作用：开关PLL，并将系统时钟切换至PLL或32k
//入口参数：:
//          PLLClk=0x00-- 切换到32K并关PLL
//          PLLClk=0x60-- pll 800k, adc 200k,并切换到800kPLL
//          PLLClk=0x65-- pll 1.6M, adc 400k,并切换到1.6MPLL
//          PLLClk=0x6a-- pll 3.2M, adc 800k,并切换到3.2PLL
//          PLLClk=0x6f -- pll 6.4M, adc 1.6M,并切换到6.4MPLL
//

//出口参数：无
//=======================================================
/*=========================================================================================\n
* @function_name: SetPLL
* @function_file: McuDrive.c
* @描述: 开关PLL
* 
* @param:   PLLClk=0x00-- 切换到32K并关PLL
*           PLLClk=0x60-- pll 800k, Adc 200k,并切换到800kPLL
*           PLLClk=0x65-- pll 1.6M, Adc 400k,并切换到1.6MPLL
*           PLLClk=0x6a-- pll 3.2M, Adc 800k,并切换到3.2PLL
*           PLLClk=0x6f -- pll 6.4M, Adc 1.6M,并切换到6.4MPLL
* 
* @return: uint8 
* @作者: lwb (2014/3/14)
* @备注: 
*-------------------------------------------------------------------------------------------
* @修改人: 
* @修改内容:  
===========================================================================================*/
uint8 SetPLL(uint8 PLLClk)
{
    uint8 tmp = 0;
    uint8 i=0;

    if(PLLClk&PLLPDN)           //判断是否开启PLL电路 BandGap
    {
        tmp = 1;
    }

    F0 = 0;                     //F0是用于快速开启PLL，如果F0=1，则CtrlCLK就无法修改系统时钟

    if((CtrlCLK != PLLClk))     //判断设置值是否跟原始值相等
    {
        CLKFRQ = 0;             //切换主时钟切换到OSC
        while(CLKFRQ);           //先将系统主时钟切到32k
        CtrlCLK = 0x20;
        for(i=0;i<10;i++);      //等待
        CtrlCLK = PLLClk;       //再切换PLL时钟
        for(i=0;i<5;i++);       //等待
    }

    CLKFRQ = tmp;               //最后切换主时钟到目标状态
	PMG=0;
    if((PLLClk&0x0c)==0x0)
    {
        CtrlBGP = 0xe2;;        //低功耗模式，全局偏置电流减少到1/3、 使能BandGap
        CtrlIAT = 0x1A;         //电流通道A调偏置电流调整
        CtrlIBT = 0x1A;         //电流通道A调偏置电流调整
        CtrlUT  = 0x1A;         //电压通道A调偏置电流调整
        CtrlMT  = 0x1A;         //M通道A调偏置电流调整
    }
    else
    {
        CtrlIAT = 0x0;
        CtrlIBT = 0x0;
        CtrlUT  = 0x0;
        CtrlMT  = 0x0;
        CtrlBGP = 0x62;         //正常模式，配置改善跳差 使能BandGap
    }

    if(CLKFRQ==0)
    {
        CtrlADC = 0;            //系统32k时，关闭ADC
    }

    CtrlCry &= ~0x70;           //调整ref电压温度系数
    return true;
}
/*=========================================================================================\n
* @function_name: SetLDOVolt
* @function_file: McuDrive.c
* @描述: 配置LDO电压
*
*
* @参数:
* @param:val_volt
* @返回:
* @作者:   lwb (2012-02-27)
* @备注:
*-------------------------------------------------------------------------------------------
* @修改人:
* @修改内容:
===========================================================================================*/
void SetLDOVolt(uint8 val_volt)
{
    uint8 tmp;

    tmp = CtrlLDO;
    tmp &= ~0x07;
    tmp |= val_volt;
    CtrlLDO = tmp;
}
/*=========================================================================================\n
* @function_name: SetLCDVolt
* @function_file: McuDrive.c
* @描述:
*
*
* @参数:
* @param:val_volt  0x80 -- 3.0v//只针对电阻分压
*                  0 -- 3.3v
*                  0x10 -- 3.5v
*                  others -- no effect
* @返回:
* @作者:   lwb (2012-02-27)
* @备注:
*-------------------------------------------------------------------------------------------
* @修改人:
* @修改内容:
===========================================================================================*/
void SetLCDVolt(uint8 val_volt)
{
    CtrlCry &= ~BIT7;               // 选择3.3V
    CtrlLDO &= ~BIT4;
    CtrlCry |= (val_volt&BIT7);
    CtrlLDO |= (val_volt&BIT4);
}
/*=========================================================================================\n
* @function_name: InitLCD
* @function_file: McuDrive.c
* @描述: 初始化LCD
*
* @参数:
* @返回:
* @作者:   lwb (2012-02-27)
* @备注:
*-------------------------------------------------------------------------------------------
* @修改人:
* @修改内容:
===========================================================================================*/
void InitLCD(void)
{
//LCD显示，必须配置为禁止输入输出
    P4OE |= 0xff;           // P4.0~P4.7
    P5OE |= 0xff;           // P5.0~P5.7
    P6OE |= 0xFf;           // P6.0~P6.7

    P4IE &=~ 0xff;          // P4.0~P4.7
    P5IE &=~ 0xff;          // P5.0~P5.7
    P6IE &=~ 0xFf;          // P6.0~P6.7

    SegCtrl0 = 0xff;        // SEG0~SEG7
    SegCtrl1 = 0xff;        // SEG8~SEG15
    SegCtrl2 = 0xFf;        // SEG16~SEG21
    LCDCtrl = 0x8E;
    SetLCDVolt(SETLCD_30V);
}
/*=========================================================================================\n
* @function_name: Check_Sfr
* @function_file: McuDrive.c
* @描述: sfr的保护
* 
* @作者: lwb (2014/3/21)
* @备注: 
*-------------------------------------------------------------------------------------------
* @修改人: 
* @修改内容:  
===========================================================================================*/
void Check_Sfr(void)
{
    if(EIE!=0xE1)
    {
        EIE=0xE1;
    }
    
    if(IE!=0xF2)
    {
        IE=0xF2;
    }
    
    if((TCON&0x50)!=0x50)
    {
        TCON|=0x50;
    }
    
    if(guc_CfOpenFlg==true)
    {
//       if((ExInt2IE&0x83)!=0x83)
//       {
//           ExInt2IE|=0x83;
//       }
       if((ExInt2IE&0x80)!=0x80)
       {
           ExInt2IE|=0x80;
       }
    }
//    else
//    {
//        if((ExInt2IE&0x03)!=0x03)
//        {
//           ExInt2IE|=0x03;
//        }
//    }
    
    if( P20FS!=0x02
       ||P21FS!=0x02
       ||P24FS!=0x02
       ||P25FS!=0x02)
    {
        P20FS=0x02;
        P21FS=0x02;
        P24FS=0x02;
        P25FS=0x02;
    }

}
/*=========================================================================================\n
* @function_name: Sleep
* @function_file: McuDrive.c
* @描述: 关LDO33,设置LDO25输出电压最低 大约2.1V
*       关AD；
*       禁止计量电路访问双口ram；
*       关闭所有计量通道；关PM时钟
*       将系统切到低频工作
*       关PLL；
*       让系统慢速进入浅睡眠。
*
* @参数:
* @返回:
* @作者:   lwb (2012-03-23)
* @备注:
*-------------------------------------------------------------------------------------------
* @修改人:
* @修改内容:
===========================================================================================*/
void Sleep(void)
{
    F0 = 0;
    CtrlMEAS = 0x80;
    CtrlLDO  &= ~0x07;
    CtrlLDO  |= BIT1;       //LDO25输出电压最低 大约2.1V
    CtrlADC = 0;            //关AD
    //关闭所有计量通道；关PM时钟
    PMCtrl1 = 0;
    PMCtrl4 = 0;
    PMG = 1;
//  switch_clk = 0;//将主时钟切换到OSC
//  F1 = 1;// PLL切换到OSC，关闭PLL，系统进入浅睡眠
    CLKFRQ = 0;//将主时钟切换到32k
    while(CLKFRQ);
    CtrlCLK = 0;//关PLL
    SLEEP1 = 0;
    SLEEP0 = 1;// 系统慢速进入深睡眠
    while(1);
    
}
/*=========================================================================================\n
* @function_name: IntOFF
* @function_file: McuDrive.c
* @描述: 关闭中断
* 
* @作者: lwb (2014/3/25)
* @备注: 
*-------------------------------------------------------------------------------------------
* @修改人: 
* @修改内容:  
===========================================================================================*/
void IntOFF(void)
{
    IE=0;
    EIE=0;
    EXIF=0;
}
/*=========================================================================================\n
* @function_name: UARTOFF
* @function_file: McuDrive.c
* @描述: 关闭所有串口
* 
* @作者: lwb (2014/3/25)
* @备注: 
*-------------------------------------------------------------------------------------------
* @修改人: 
* @修改内容:  
===========================================================================================*/
void UARTOFF(void)
{
    TCON =0;
    TCON2=0;
    TCON3=0;
    TCON4=0;
}

#ifdef _SW_EXT_RTC
/*=========================================================================================\n
* @function_name: GetExtRTC
* @function_file: McuDrive.c
* @描述: 读取硬件时钟
*
* @参数:
* @返回:
* @作者:   lwb (2012-02-29)
* @备注:
*-------------------------------------------------------------------------------------------
* @修改人:
* @修改内容:
===========================================================================================*/
void GetExtRTC(void)
{
    gs_ClkTmp.ucSecond  = RTCSC;
    gs_ClkTmp.ucMinute  = RTCMiC;
    gs_ClkTmp.ucHour    = RTCHC;
    gs_ClkTmp.ucWeek    = RTCWC;
    gs_ClkTmp.ucDay     = RTCDC;
    gs_ClkTmp.ucMonth   = RTCMoC;
    gs_ClkTmp.ucYear    = RTCYC;
}
/*=========================================================================================\n
* @function_name: SetExtRTC
* @function_file: McuDrive.c
* @描述: 设置RTC时钟
*
* @参数:
* @返回:
* @作者:   lwb (2012-02-29)
* @备注:
*-------------------------------------------------------------------------------------------
* @修改人:
* @修改内容:
===========================================================================================*/
void SetExtRTC(void)
{
    //RTC允许写
    RTCPEN = 0x96;      //password 1
    RTCPWD = 0xd7;      //password 2
    //写RTC时间
    RTCYC   = gs_DateTime.ucYear;
    RTCMoC  = gs_DateTime.ucMonth;
    RTCDC   = gs_DateTime.ucDay;
    RTCHC   = gs_DateTime.ucHour;
    RTCMiC  = gs_DateTime.ucMinute;
    RTCSC   = gs_DateTime.ucSecond;
    RTCWC   = gs_DateTime.ucWeek;
    //RTC禁止写
    RTCPEN = 0x96;
    RTCPWD = 0xd6;
}
#endif
